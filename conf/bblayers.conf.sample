## conf/bblayers.conf.sample
```bitbake
#
# This file is part of Liri.
#
# Copyright (C) 2016 Pier Luigi Fiorini <pierluigi.fiorini@gmail.com>
#
# $BEGIN_LICENSE:GPL3+$
#
# This program is free software: you can redistribute it and/or modify
# it under the terms of the GNU General Public License as published by
# the Free Software Foundation, either version 3 of the License, or
# (at your option) any later version.
#
# This program is distributed in the hope that it will be useful,
# but WITHOUT ANY WARRANTY; without even the implied warranty of
# MERCHANTABILITY or FITNESS FOR A PARTICULAR PURPOSE.  See the
# GNU General Public License for more details.
#
# You should have received a copy of the GNU General Public License
# along with this program.  If not, see <http://www.gnu.org/licenses/>.
#
# $END_LICENSE$
#

# LAYER_CONF_VERSION is increased each time build/conf/bblayers.conf
# changes incompatibly
LCONF_VERSION = "6"

BBPATH = "${TOPDIR}"
BBFILES ?= ""
BSPDIR := "${@os.path.abspath(os.path.dirname(d.getVar('FILE', True)) + '/../..')}"

BBLAYERS ?= " \
    ${BSPDIR}/sources/poky/meta \
    ${BSPDIR}/sources/poky/meta-yocto \
    ${BSPDIR}/sources/meta-fsl-arm \
    ${BSPDIR}/sources/meta-fsl-arm-extra \
    ${BSPDIR}/sources/meta-beagleboard/common-bsp \
    ${BSPDIR}/sources/meta-ti \
    ${BSPDIR}/sources/meta-raspberrypi \
    ${BSPDIR}/sources/meta-toradex \
    ${BSPDIR}/sources/meta-openembedded/meta-oe \
    ${BSPDIR}/sources/meta-openembedded/meta-multimedia \
    ${BSPDIR}/sources/meta-openembedded/meta-gnome \
    ${BSPDIR}/sources/meta-boot2qt \
    ${BSPDIR}/sources/meta-boot2qt/meta-ti-extras \
    ${BSPDIR}/sources/meta-boot2qt/meta-fsl-extras \
    ${BSPDIR}/sources/meta-boot2qt/meta-beagleboard-extras \
    ${BSPDIR}/sources/meta-boot2qt/meta-toradex-extras \
    ${BSPDIR}/sources/meta-mingw \
    ${BSPDIR}/sources/meta-qt5 \
    ${BSPDIR}/sources/meta-qt5-extra \
    ${BSPDIR}/sources/meta-liri \
"
BBLAYERS_NON_REMOVABLE ?= " \
    ${BSPDIR}/sources/poky/meta \
    ${BSPDIR}/sources/poky/meta-yocto \
"
```

## conf/distro/include/raspberrypi.inc
```bitbake
#
# This file is part of Liri.
#
# Copyright (C) 2017 Pier Luigi Fiorini <pierluigi.fiorini@gmail.com>
#
# $BEGIN_LICENSE:GPL3+$
#
# This program is free software: you can redistribute it and/or modify
# it under the terms of the GNU General Public License as published by
# the Free Software Foundation, either version 3 of the License, or
# (at your option) any later version.
#
# This program is distributed in the hope that it will be useful,
# but WITHOUT ANY WARRANTY; without even the implied warranty of
# MERCHANTABILITY or FITNESS FOR A PARTICULAR PURPOSE.  See the
# GNU General Public License for more details.
#
# You should have received a copy of the GNU General Public License
# along with this program.  If not, see <http://www.gnu.org/licenses/>.
#
# $END_LICENSE$
#

IMAGE_FSTYPES += "ext3 rpi-sdimg"

QBSP_IMAGE_CONTENT ?= "\
    ${IMAGE_LINK_NAME}.img \
    ${IMAGE_LINK_NAME}.conf \
"

MACHINE_EXTRA_INSTALL += "\
    omxplayer \
"

KERNEL_MODULE_AUTOLOAD += "snd-bcm2835 bcm2835-v4l2"
KERNEL_MODULE_PROBECONF += "bcm2835-v4l2"
module_conf_bcm2835-v4l2 = "options bcm2835-v4l2 gst_v4l2src_is_broken=1"

# Video camera support
VIDEO_CAMERA = "1"

MACHINE_FEATURES += "pitft"
```

## conf/distro/lirios.conf
```bitbake
#
# This file is part of Liri.
#
# Copyright (C) 2016 Pier Luigi Fiorini <pierluigi.fiorini@gmail.com>
#
# $BEGIN_LICENSE:GPL3+$
#
# This program is free software: you can redistribute it and/or modify
# it under the terms of the GNU General Public License as published by
# the Free Software Foundation, either version 3 of the License, or
# (at your option) any later version.
#
# This program is distributed in the hope that it will be useful,
# but WITHOUT ANY WARRANTY; without even the implied warranty of
# MERCHANTABILITY or FITNESS FOR A PARTICULAR PURPOSE.  See the
# GNU General Public License for more details.
#
# You should have received a copy of the GNU General Public License
# along with this program.  If not, see <http://www.gnu.org/licenses/>.
#
# $END_LICENSE$
#

include conf/distro/poky.conf

DISTRO = "lirios"
DISTRO_NAME = "Liri OS"
DISTRO_VERSION = "1.0.0"
DISTRO_CODENAME = "liri"

SDK_VENDOR = "-lirisdk"
SDK_VERSION := "${DISTRO_VERSION}"
SDK_MACHINE = "${@d.getVar('SDKMACHINE', True) or '${SDK_ARCH}'}"
SDK_NAME = "${DISTRO}-${SDK_MACHINE}-${IMAGE_BASENAME}"
TOOLCHAIN_OUTPUTNAME = "${SDK_NAME}-${MACHINE}"
BUILDCFG_VARS += "SDKMACHINE"

MAINTAINER = "Pier Luigi Fiorini <pierluigi.fiorini@gmail.com>"

TARGET_VENDOR = "-lirios"

SYSVINIT_ENABLED_GETTYS = ""

DISTRO_FEATURES_DEFAULT = "alsa argp bluetooth ext2 largefile pulseaudio usbgadget usbhost wifi xattr nfs wayland webengine pam"
POKY_DEFAULT_DISTRO_FEATURES = "largefile opengl multiarch"
DISTRO_FEATURES_BACKFILL_CONSIDERED = "sysvinit"

FONTCONFIG_CACHE_DIR = "${libdir}/fontconfig/cache"

# Enable XWayland
DISTRO_FEATURES += "x11"
PREFERRED_PROVIDER_virtual/xserver = "xserver-xorg-xwayland"

# Use GStreamer 1.0, optionally change to "gstreamer010" to use GStreamer 0.10
DISTRO_FEATURES += " gstreamer"

DISTRO_FEATURES += " systemd"
VIRTUAL-RUNTIME_init_manager = "systemd"
VIRTUAL-RUNTIME_initscripts = ""
PREFERRED_PROVIDER_udev ?= "systemd"
PREFERRED_PROVIDER_udev-utils ?= "systemd"

PREFERRED_PROVIDER_jpeg ?= "libjpeg-turbo"
PREFERRED_PROVIDER_jpeg-native ?= "libjpeg-turbo-native"

#DISTRO_FEATURES += " flatpak"
PREFERRED_VERSION_flatpak = "0.6.9"

MACHINE_EXTRA_INSTALL ?= ""
MACHINE_EXTRA_INSTALL_SDK ?= ""
MACHINE_EXTRA_INSTALL_SDK_HOST ?= ""

# Override mkspec for mingw build
OE_QMAKE_PLATFORM_NATIVE_mingw32 = "win32-g++-oe"
OE_QMAKE_PLATFORM_mingw32 = "win32-g++-oe"

# Disable SHA validation for branch
QT_MODULE_BRANCH_PARAM = "nobranch=1"

PACKAGE_EXCLUDE_COMPLEMENTARY ?= "qtquickcompiler"

IMAGE_FSTYPES = "conf"
IMAGE_CLASSES += "image_types_sdcard deploy-conf"

LICENSE_CREATE_PACKAGE = "1"
COPY_LIC_MANIFEST = "1"

include conf/distro/machines/${MACHINE}.conf
```

## conf/distro/machines/raspberrypi.inc
```bitbake
#
# This file is part of Liri.
#
# Copyright (C) 2017 Pier Luigi Fiorini <pierluigi.fiorini@gmail.com>
#
# $BEGIN_LICENSE:GPL3+$
#
# This program is free software: you can redistribute it and/or modify
# it under the terms of the GNU General Public License as published by
# the Free Software Foundation, either version 3 of the License, or
# (at your option) any later version.
#
# This program is distributed in the hope that it will be useful,
# but WITHOUT ANY WARRANTY; without even the implied warranty of
# MERCHANTABILITY or FITNESS FOR A PARTICULAR PURPOSE.  See the
# GNU General Public License for more details.
#
# You should have received a copy of the GNU General Public License
# along with this program.  If not, see <http://www.gnu.org/licenses/>.
#
# $END_LICENSE$
#

IMAGE_FSTYPES += "ext3 rpi-sdimg"

MACHINE_FEATURES += "pitft vc4graphics"

MACHINE_EXTRA_INSTALL += "\
    ${@bb.utils.contains('MACHINE_FEATURES', 'vc4graphics', '', 'omxplayer', d)} \
"

# Remove splash
IMAGE_FEATURES_remove = "splash"

KERNEL_MODULE_AUTOLOAD += "snd-bcm2835 bcm2835-v4l2"
KERNEL_MODULE_PROBECONF += "bcm2835-v4l2"
module_conf_bcm2835-v4l2 = "options bcm2835-v4l2 gst_v4l2src_is_broken=1"

# Video camera support
VIDEO_CAMERA = "1"

# Dispmanx offline compositing
DISPMANX_OFFLINE = "1"

# Preferred providers for GL
PREFERRED_PROVIDER_virtual/egl = "${@bb.utils.contains("MACHINE_FEATURES", "vc4graphics", "mesa", "userland", d)}"
PREFERRED_PROVIDER_virtual/libgles2 = "${@bb.utils.contains("MACHINE_FEATURES", "vc4graphics", "mesa", "userland", d)}"
PREFERRED_PROVIDER_virtual/libgl = "${@bb.utils.contains("MACHINE_FEATURES", "vc4graphics", "mesa", "mesa-gl", d)}"
PREFERRED_PROVIDER_virtual/mesa = "${@bb.utils.contains("MACHINE_FEATURES", "vc4graphics", "mesa", "mesa-gl", d)}"
PREFERRED_PROVIDER_libgbm = "${@bb.utils.contains("MACHINE_FEATURES", "vc4graphics", "mesa", "mesa-gl", d)}"
```

## conf/layer.conf
```bitbake
#
# This file is part of Liri.
#
# Copyright (C) 2016 Pier Luigi Fiorini <pierluigi.fiorini@gmail.com>
#
# $BEGIN_LICENSE:GPL3+$
#
# This program is free software: you can redistribute it and/or modify
# it under the terms of the GNU General Public License as published by
# the Free Software Foundation, either version 3 of the License, or
# (at your option) any later version.
#
# This program is distributed in the hope that it will be useful,
# but WITHOUT ANY WARRANTY; without even the implied warranty of
# MERCHANTABILITY or FITNESS FOR A PARTICULAR PURPOSE.  See the
# GNU General Public License for more details.
#
# You should have received a copy of the GNU General Public License
# along with this program.  If not, see <http://www.gnu.org/licenses/>.
#
# $END_LICENSE$
#

# We have a conf and classes directory, append to BBPATH
BBPATH .= ":${LAYERDIR}"

# We have a recipes directory, add to BBFILES
BBFILES += " \
    ${LAYERDIR}/recipes/*/*.bb \
    ${LAYERDIR}/recipes/*/*.bbappend \
    ${LAYERDIR}/recipes-devtools/*/*.bb \
    ${LAYERDIR}/recipes-devtools/*/*.bbappend \
    ${LAYERDIR}/recipes-liri/*/*.bb \
    ${LAYERDIR}/recipes-liri/*/*.bbappend \
    ${LAYERDIR}/recipes-liri/*.bbappend \
"
BBFILES += "${@bb.utils.contains("BBFILE_COLLECTIONS", "qt5-layer", "${LAYERDIR}/recipes-qt/*/*.bb ${LAYERDIR}/recipes-qt/*/*.bbappend" , "", d)}"

BBFILE_COLLECTIONS += "lirios"
BBFILE_PATTERN_lirios := "^${LAYERDIR}/"
BBFILE_PRIORITY_lirios = "20"

LICENSE_PATH += "${LAYERDIR}"
```

## meta-qt5-extra/conf/layer.conf
```bitbake
#
# This file is part of Liri.
#
# Copyright (C) 2017 Pier Luigi Fiorini <pierluigi.fiorini@gmail.com>
#
# $BEGIN_LICENSE:GPL3+$
#
# This program is free software: you can redistribute it and/or modify
# it under the terms of the GNU General Public License as published by
# the Free Software Foundation, either version 3 of the License, or
# (at your option) any later version.
#
# This program is distributed in the hope that it will be useful,
# but WITHOUT ANY WARRANTY; without even the implied warranty of
# MERCHANTABILITY or FITNESS FOR A PARTICULAR PURPOSE.  See the
# GNU General Public License for more details.
#
# You should have received a copy of the GNU General Public License
# along with this program.  If not, see <http://www.gnu.org/licenses/>.
#
# $END_LICENSE$
#

# Append conf directory to BBPATH
BBPATH .= ":${LAYERDIR}"

# Add recipes
BBFILES += " \
    ${LAYERDIR}/recipes*/*/*.bb \
    ${LAYERDIR}/recipes*/*/*.bbappend \
"

BBFILE_COLLECTIONS += "lirios_qt5_extra"
BBFILE_PATTERN_lirios_qt5_extra := "^${LAYERDIR}/"
BBFILE_PRIORITY_lirios_qt5_extra = "20"
```
